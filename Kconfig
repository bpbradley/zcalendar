## Kconfig
```kconfig
# Copyright (c) 2020 Brian Bradley
# SPDX-License-Identifier: Apache-2.0

menuconfig CALENDAR
	bool "Enable the calendar API"
	select CONFIG_APPLICATION_DEFINED_SYSCALL
	help
	  Enable calendar api

if CALENDAR

module = CALENDAR
module-str = calendar
source "subsys/logging/Kconfig.template.log_config"

config CALENDAR_INIT_TIME_UNIX_TIMESTAMP
	int "Set the initialization time as a unix timestamp"
	range 946684800 4070908800
	default 946684800
	help
		The time is stored as a unix timestamp (seconds from epoch)
		where epoch is January 1 1970

rsource "Kconfig.stm32"
rsource "Kconfig.ds3231"
rsource "Kconfig.microcrystal_rv"
endif
```

## Kconfig.ds3231
```kconfig
# Copyright (c) 2020 Brian Bradley
# SPDX-License-Identifier: Apache-2.0

menuconfig DS3231_RTC_CALENDAR
	bool "Maxim DS3231 RTC based calendar API implementation"
	select COUNTER
	select COUNTER_MAXIM_DS3231
	help
	  Enable driver for Maxim DS3231 rtc time api
```

## Kconfig.microcrystal_rv
```kconfig
# Copyright (c) 2022 Brian Bradley
# SPDX-License-Identifier: Apache-2.0

menuconfig MICROCRYSTAL_RV_RTC_CALENDAR
	bool "Microcrystal rv-xxxx based calendar API implementation"
	select I2C
	help
	  Enable driver for a Micro Crystal rtc time api

config RESET_BACKUP_DOMAIN
	bool "Optionally force a reset of the backup domain on init"

choice
	prompt "Microcrystal RTC Variant"
	default MICROCRYSTAL_RTC_RV8263
	
config MICROCRYSTAL_RTC_RV8263
	bool "Select the RV8263"

config MICROCRYSTAL_RTC_RV3032
	bool "Select the RV3032"
endchoice

config MICROCRYSTAL_RTC_USE_SRAM_MAGIC
	bool "Optionally use a magic word in SRAM to indicate a first program"
	default y if MICROCRYSTAL_RTC_RV8263
	default n if MICROCRYSTAL_RTC_RV3032

if MICROCRYSTAL_RTC_RV3032

choice
	prompt "rv3032 switchover behavior"
	default RV3032_SWITCHOVER_DISABLED

config RV3032_SWITCHOVER_DISABLED
	bool "Switchover Disabled mode"

config RV3032_DIRECT_SWITCHING_MODE
	bool "Direct Switching Mode (DSM)"

config RV3032_LEVEL_SWITCHING_MODE
	bool "Level Switching Mode (LSM)"
endchoice

choice
	prompt "rv3032 trickle charge behavior"
	default RV3032_TCM_DISABLED
config RV3032_TCM_DISABLED
	bool "Trickle Charge disabled"
config RV3032_TCM_1V75
	bool "1.75V trickle charging"
config RV3032_TCM_3V0
	bool "3.0V trickle charging"
config RV3032_TCM_4V5
	bool "4.5V trickle charging"
endchoice


choice
	prompt "rv3032 trickle charge series resistance"
	default RV3032_TCR_0K6_OHM
config RV3032_TCR_0K6_OHM
	bool "600 Ohm trickle charger series resistance"
config RV3032_TCR_2K0_OHM
	bool "2 kOhm trickle charger series resistance"
config RV3032_TCR_7K0_OHM
	bool "7 kOhm trickle charger series resistance"
config RV3032_TCR_12K0_OHM
	bool "12 kOhm trickle charger series resistance"
endchoice

choice
	prompt "rv3032 clockout"
	default RV3032_CLKOUT_ENABLED

config RV3032_CLKOUT_ENABLED
	bool "Clock output enabled"

config RV3032_CLKOUT_DISABLED
	bool "Clock output disabled"
endchoice

config RV3032_SWITCHOVER_MODE_MASK
	hex
	default 0x00 if RV3032_SWITCHOVER_DISABLED
	default 0x10 if RV3032_DIRECT_SWITCHING_MODE
	default 0x20 if RV3032_LEVEL_SWITCHING_MODE

config RV3032_TCM_MASK
	hex
	default 0x00 if RV3032_TCM_DISABLED
	default 0x01 if RV3032_TCM_1V75
	default 0x02 if RV3032_TCM_3V0
	default 0x03 if RV3032_TCM_4V5

config RV3032_CLKOUT_ENABLE_MASK
	hex
	default 0x00 if RV3032_CLKOUT_ENABLED
	default 0x40 if RV3032_CLKOUT_DISABLED

config RV3032_TCR_MASK
	hex
	default 0x00 if RV3032_TCR_0K6_OHM
	default 0x04 if RV3032_TCR_2K0_OHM
	default 0x08 if RV3032_TCR_7K0_OHM
	default 0x0C if RV3032_TCR_12K0_OHM
endif
```

## Kconfig.rv8263
```kconfig
# Copyright (c) 2022 Brian Bradley
# SPDX-License-Identifier: Apache-2.0

menuconfig RV8263_RTC_CALENDAR
	bool "RV8263 based calendar API implementation"
	select I2C
	help
	  Enable driver for Micro Crystal RV8263 rtc time api

config RESET_BACKUP_DOMAIN
	bool "Optionally force a reset of the backup domain on init"
```

## Kconfig.stm32
```kconfig
# Copyright (c) 2020 Brian Bradley
# SPDX-License-Identifier: Apache-2.0

menuconfig STM32_RTC_CALENDAR
	bool "STM32 RTC based calendar API implementation"
	depends on SOC_FAMILY_STM32
	select USE_STM32_LL_RTC
	select USE_STM32_LL_PWR
	select USE_STM32_LL_RCC
	select USE_STM32_LL_EXTI
	select REQUIRES_FULL_LIBC
	help
	  Enable driver for stm32 rtc time api

config RESET_BACKUP_DOMAIN
	bool "Optionally force a reset of the backup domain on init"
```

## dts/bindings/calendar.yaml
```yaml
compatible: "calendar"

include: base.yaml

description: Device tree bindings for calendar API

properties:
  rtc:
    type: phandle
    required: true
    description: The handle of the underlying device used to store time
  
```

## dts/bindings/microcrystal,rv-calendar.yaml
```yaml
#
# Copyright (c) 2022 Brian Bradley
#
# SPDX-License-Identifier: Apache-2.0
#
description: Micro Crystal I2C RTC Calendar

compatible: "microcrystal,rv-calendar"

include: i2c-device.yaml

properties:
  reg:
    required: true
```
